## buildroot/configs/kiln_rock4d_713_defconfig
```kconfig
BR2_aarch64=y

# Buildroot-internal glibc toolchain (external /usr toolchain breaks on Ubuntu
# 24.04 aarch64; same choice as the rocket tree's rock4d_npu_defconfig).
BR2_TOOLCHAIN_BUILDROOT_GLIBC=y
BR2_KERNEL_HEADERS_6_6=y
BR2_TOOLCHAIN_BUILDROOT_CXX=y
# RK3576 = Cortex-A72 + Cortex-A53, both ARMv8.0-A (no LSE atomics).
BR2_TARGET_OPTIMIZATION="-mcpu=cortex-a72.cortex-a53"

BR2_TARGET_GENERIC_HOSTNAME="rock4d-kiln"
BR2_TARGET_GENERIC_ISSUE="Kiln RK3576 NPU (vendor rknpu + RKLLM on mainline)"
BR2_SYSTEM_DHCP="eth0"
BR2_TARGET_GENERIC_ROOT_PASSWD="root"
BR2_INIT_BUSYBOX=y

# Kiln post-build: build+install out-of-tree rknpu.ko, install runtimes, model.
# The Kiln repo path is passed as the post-script arg.
# Overlay: /usr/bin/kiln-chat + /etc/profile.d/kiln-chat.sh (login -> NPU chat).
BR2_ROOTFS_OVERLAY="$(BR2_EXTERNAL_KILN_PATH)/rootfs"
BR2_ROOTFS_POST_BUILD_SCRIPT="$(BR2_EXTERNAL_KILN_PATH)/board/rock4d/post-build.sh"
BR2_ROOTFS_POST_IMAGE_SCRIPT="$(BR2_EXTERNAL_KILN_PATH)/board/rock4d/post-image.sh"
BR2_ROOTFS_POST_SCRIPT_ARGS="$(BR2_EXTERNAL_KILN_PATH)/.."

BR2_LINUX_KERNEL=y
# Kernel source overridden at build time via LINUX_OVERRIDE_SRCDIR in the
# generated local.mk (points at the mainline 7.1.3 tree with kernel-patches/
# 0001-0010 applied -- NOT linux-next).
BR2_LINUX_KERNEL_CUSTOM_VERSION=y
BR2_LINUX_KERNEL_CUSTOM_VERSION_VALUE="7.1.3-kiln"
BR2_LINUX_KERNEL_USE_CUSTOM_CONFIG=y
# base.config is copied into dl/ by build-image.sh from the kernel tree.
BR2_LINUX_KERNEL_CUSTOM_CONFIG_FILE="$(BR2_EXTERNAL_KILN_PATH)/dl/base.config"
# Kiln fragment turns CONFIG_DRM_ACCEL_ROCKET off (vendor rknpu binds the NPU).
BR2_LINUX_KERNEL_CONFIG_FRAGMENT_FILES="$(BR2_EXTERNAL_KILN_PATH)/npu.fragment"
BR2_LINUX_KERNEL_IMAGE_TARGET_CUSTOM=y
BR2_LINUX_KERNEL_IMAGE_TARGET_NAME="Image"
BR2_LINUX_KERNEL_DTS_SUPPORT=y
# The vendor rknpu node + IOMMUs are added to the in-tree rk3576-rock-4d dtb by
# kernel-patches/0004 (KERNEL_SRC must have 0001-0010 applied); clk_npu via CRU
# (not SCMI). So we build the stock in-tree DTS name, no custom/overlay DTS.
# Kiln-only image: build ONLY the kiln dtb (the -rocket variant is dropped; the
# open rocket driver is off in npu.fragment).
BR2_LINUX_KERNEL_INTREE_DTS_NAME="rockchip/rk3576-rock-4d"
BR2_LINUX_KERNEL_NEEDS_HOST_OPENSSL=y
BR2_LINUX_KERNEL_INSTALL_TARGET=y

BR2_PACKAGE_BUSYBOX=y
BR2_PACKAGE_DROPBEAR=y
# librkllmrt/librknnrt need libstdc++/libgomp/pthread (in the toolchain) + libdrm
# (librkllmrt statically links its own libdrm, but libdrm on target is harmless).
BR2_PACKAGE_LIBDRM=y

# --- base tools + debug chain -----------------------------------------------
# whiptail is required for kiln-config / the `kiln` menu; the rest is a working
# on-board debug set (busybox alone is too thin for NPU/driver bring-up).
BR2_PACKAGE_NEWT=y            # provides whiptail
BR2_PACKAGE_SUDO=y
BR2_PACKAGE_BINUTILS=y        # strings / objdump / nm / readelf / addr2line
BR2_PACKAGE_MAKE=y
BR2_PACKAGE_PKGCONF=y
BR2_PACKAGE_GDB=y
BR2_PACKAGE_GDB_DEBUGGER=y    # full gdb on the target (not just gdbserver)
BR2_PACKAGE_STRACE=y
BR2_PACKAGE_FILE=y
BR2_PACKAGE_LSOF=y
BR2_PACKAGE_PROCPS_NG=y       # ps / top / free / pkill (fuller than busybox)
BR2_PACKAGE_HTOP=y
BR2_PACKAGE_PCIUTILS=y        # lspci
BR2_PACKAGE_USBUTILS=y        # lsusb
BR2_PACKAGE_ETHTOOL=y
BR2_PACKAGE_I2C_TOOLS=y       # i2cdetect/i2cget -- handy for RK PMIC/board probing
BR2_PACKAGE_NANO=y            # a friendly editor next to busybox vi

BR2_TARGET_ROOTFS_EXT2=y
BR2_TARGET_ROOTFS_EXT2_4=y
# 1536 MiB: fits the 668 MB model baked into /opt/models + libs + rknpu.ko + demo
# + ext4 headroom (build uses KILN_BAKE_MODEL=1). Drop to 768M and unset
# KILN_BAKE_MODEL to keep the model out and scp it instead.
BR2_TARGET_ROOTFS_EXT2_SIZE="2560M"
```

## buildroot/configs/kiln_rock5b_713_defconfig
```kconfig
BR2_aarch64=y

# Buildroot-internal glibc toolchain (external /usr toolchain breaks on Ubuntu
# 24.04 aarch64; same choice as the rock4d defconfig).
BR2_TOOLCHAIN_BUILDROOT_GLIBC=y
BR2_KERNEL_HEADERS_6_6=y
BR2_TOOLCHAIN_BUILDROOT_CXX=y
# RK3588 = Cortex-A76 + Cortex-A55 (ARMv8.2-A, has LSE atomics), unlike RK3576's
# A72+A53 (ARMv8.0). Build for the big.LITTLE pair.
BR2_TARGET_OPTIMIZATION="-mcpu=cortex-a76.cortex-a55"

BR2_TARGET_GENERIC_HOSTNAME="rock5b-kiln"
BR2_TARGET_GENERIC_ISSUE="Kiln RK3588 NPU (vendor rknpu + RKLLM on mainline) -- SKELETON, unvalidated"
BR2_SYSTEM_DHCP="eth0"
BR2_TARGET_GENERIC_ROOT_PASSWD="root"
BR2_INIT_BUSYBOX=y

# Kiln post-build: build+install out-of-tree rknpu.ko (same binary as RK3576 --
# it already carries the rockchip,rk3588-rknpu match), install runtimes, seed
# config. The Kiln repo path is passed as the post-script arg. Overlay is shared
# with RK3576 (SoC-agnostic userspace + login MOTD).
BR2_ROOTFS_OVERLAY="$(BR2_EXTERNAL_KILN_PATH)/rootfs"
BR2_ROOTFS_POST_BUILD_SCRIPT="$(BR2_EXTERNAL_KILN_PATH)/board/rock5b/post-build.sh"
BR2_ROOTFS_POST_IMAGE_SCRIPT="$(BR2_EXTERNAL_KILN_PATH)/board/rock5b/post-image.sh"
BR2_ROOTFS_POST_SCRIPT_ARGS="$(BR2_EXTERNAL_KILN_PATH)/.."

BR2_LINUX_KERNEL=y
# Kernel source overridden at build time via LINUX_OVERRIDE_SRCDIR in the
# generated local.mk (points at the mainline 7.1.3 tree with the
# kernel-patches-rk3588/ series applied).
BR2_LINUX_KERNEL_CUSTOM_VERSION=y
BR2_LINUX_KERNEL_CUSTOM_VERSION_VALUE="7.1.3-kiln"
BR2_LINUX_KERNEL_USE_CUSTOM_CONFIG=y
# base.config is copied into dl/ by build-image.sh from the kernel tree. NOTE: for
# RK3588 this MUST be an RK3588 base config (not the RK3576 one) -- see
# kernel-patches-rk3588/README.md.
BR2_LINUX_KERNEL_CUSTOM_CONFIG_FILE="$(BR2_EXTERNAL_KILN_PATH)/dl/base.config"
# RK3588 NPU platform config (restates DRM/IOMMU/SCMI/pmdomain; the NPU clock is
# via SCMI on RK3588, so COMMON_CLK_SCMI is mandatory).
BR2_LINUX_KERNEL_CONFIG_FRAGMENT_FILES="$(BR2_EXTERNAL_KILN_PATH)/npu-rk3588.fragment"
BR2_LINUX_KERNEL_IMAGE_TARGET_CUSTOM=y
BR2_LINUX_KERNEL_IMAGE_TARGET_NAME="Image"
BR2_LINUX_KERNEL_DTS_SUPPORT=y
# Kiln RK3588 DTB: kernel-patches-rk3588/0001 adds rk3588-rock-5b-kiln.dts, which
# deletes the mainline accel/rocket rknn_core nodes and reshapes core 0 into a
# single vendor rockchip,rk3588-rknpu node bound by the out-of-tree rknpu.ko.
BR2_LINUX_KERNEL_INTREE_DTS_NAME="rockchip/rk3588-rock-5b-kiln"
BR2_LINUX_KERNEL_NEEDS_HOST_OPENSSL=y
BR2_LINUX_KERNEL_INSTALL_TARGET=y

BR2_PACKAGE_BUSYBOX=y
BR2_PACKAGE_DROPBEAR=y
# librkllmrt/librknnrt need libstdc++/libgomp/pthread (in the toolchain) + libdrm.
BR2_PACKAGE_LIBDRM=y

# --- base tools + debug chain (same set as RK3576) --------------------------
BR2_PACKAGE_NEWT=y            # provides whiptail (kiln-config / the `kiln` menu)
BR2_PACKAGE_SUDO=y
BR2_PACKAGE_BINUTILS=y        # strings / objdump / nm / readelf / addr2line
BR2_PACKAGE_MAKE=y
BR2_PACKAGE_PKGCONF=y
BR2_PACKAGE_GDB=y
BR2_PACKAGE_GDB_DEBUGGER=y
BR2_PACKAGE_STRACE=y
BR2_PACKAGE_FILE=y
BR2_PACKAGE_LSOF=y
BR2_PACKAGE_PROCPS_NG=y
BR2_PACKAGE_HTOP=y
BR2_PACKAGE_PCIUTILS=y
BR2_PACKAGE_USBUTILS=y
BR2_PACKAGE_ETHTOOL=y
BR2_PACKAGE_I2C_TOOLS=y
BR2_PACKAGE_NANO=y

BR2_TARGET_ROOTFS_EXT2=y
BR2_TARGET_ROOTFS_EXT2_4=y
# 2560 MiB: libs + rknpu.ko + demos + ext4 headroom. RK3588 is a 6 TOPS / 3-core
# LLM+vision target, so a baked .rkllm (KILN_BAKE_MODEL=1) fits; drop to 768M and
# unset KILN_BAKE_MODEL to keep the model out and scp it instead.
BR2_TARGET_ROOTFS_EXT2_SIZE="2560M"
```
